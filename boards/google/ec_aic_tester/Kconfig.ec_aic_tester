## firmware/dts/bindings/zephyr,uart-bridge.yaml
```yaml
# Copyright 2024 The ChromiumOS Authors
# Use of this source code is governed by a BSD-style license that can be
# found in the LICENSE file.

description: |
  UART bridge

  Bridges data from two serial devices, for example a USB CDC-ACM serial port
  and an hardware UART.

  The device node must have exactly two child nodes for the two devices to be
  bridged together. Example configuration:

  uart-bridge {
           compatible = "zephyr,uart-bridge";
           usb {
                   device = <&cdc_acm_uart_ec>;
                   transfer-size = <64>;
           };
           uart {
                   device = <&uart4>;
                   transfer-size = <1>;
           };
   };

compatible: "zephyr,uart-bridge"

properties:
  peers:
    type: phandles
    description: Peer device nodes, must contain two phandles
```
